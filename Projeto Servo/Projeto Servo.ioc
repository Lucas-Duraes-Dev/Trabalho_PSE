# file: Projeto Servo.ioc
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Mcu.Family=STM32F4
PC15-OSC32_OUT.Mode=LSE-External-Oscillator
PH0-OSC_IN.Signal=RCC_OSC_IN
RCC.CortexFreq_Value=250000
RCC.APB1CLKDivider=RCC_HCLK_DIV8
PC14-OSC32_IN.Signal=RCC_OSC32_IN
ProjectManager.StackSize=0x400
PA13.Signal=SYS_JTMS-SWDIO
ProjectManager.TargetToolchain=STM32CubeIDE
RCC.HCLKFreq_Value=250000
RCC.APB2TimFreq_Value=62500
TIM3.Period=1250
PC7.Signal=S_TIM3_CH2
RCC.USBFreq_Value=96000000
PC15-OSC32_OUT.Signal=RCC_OSC32_OUT
RCC.AHBFreq_Value=250000
PH0-OSC_IN.Mode=HSE-External-Oscillator
SH.S_TIM3_CH2.0=TIM3_CH2,PWM Generation2 CH2
board=custom
RCC.VCOOutputFreq_Value=192000000
RCC.APB2Freq_Value=31250
PC14-OSC32_IN.Mode=LSE-External-Oscillator
PA14.Mode=Serial_Wire
PH1-OSC_OUT.Signal=RCC_OSC_OUT
RCC.AHBCLKDivider=RCC_SYSCLK_DIV64
PA13.Mode=Serial_Wire
Mcu.Name=STM32F446R(C-E)Tx
PC7.GPIO_Label=Fio Laranja
PH1-OSC_OUT.Mode=HSE-External-Oscillator
Mcu.Package=LQFP64
PA14.Signal=SYS_JTCK-SWCLK
ProjectManager.HeapSize=0x200
NVIC.PriorityGroup=NVIC_PRIORITYGROUP_4
RCC.APB2CLKDivider=RCC_HCLK_DIV8
TIM3.Channel-PWM\ Generation2\ CH2=TIM_CHANNEL_2
RCC.APB1TimFreq_Value=62500
TIM3.Pulse-PWM\ Generation2\ CH2=94
RCC.APB1Freq_Value=31250
VP_TIM3_VS_ClockSourceINT.Mode=Internal

// file: Core/Src/main.c
/* USER CODE BEGIN Header */
/**
  ******************************************************************************
  * @file           : main.c
  * @brief          : Main program body
  ******************************************************************************
  * @attention
  *
  * <h2><center>&copy; Copyright (c) 2023 STMicroelectronics.
  * All rights reserved.</center></h2>
  *
  * This software component is licensed by ST under BSD 3-Clause license,
  * the "License"; You may not use this file except in compliance with the
  * License. You may obtain a copy of the License at:
  *                        opensource.org/licenses/BSD-3-Clause
  *
  ******************************************************************************
  */
/* USER CODE END Header */
#include "main.h"

/* USER CODE BEGIN Includes */
#include "SERVOMOTOR.h"
/* USER CODE END Includes */

TIM_HandleTypeDef htim3;
uint16_t angulo1 = 90;
uint16_t angulo2 = 180;
uint16_t i;

void SystemClock_Config(void);
static void MX_GPIO_Init(void);
static void MX_TIM3_Init(void);

int main(void)
{

  /* MCU Configuration--------------------------------------------------------*/

  /* Reset of all peripherals, Initializes the Flash interface and the Systick. */
  HAL_Init();

  /* Configure the system clock */
  SystemClock_Config();

  /* Initialize all configured peripherals */
  MX_GPIO_Init();
  MX_TIM3_Init();

  /* Infinite loop */
  while (1)
  {

    /* USER CODE BEGIN 3 */

	  /*
	  // MOVER DE 0º a 90º
	  for(i = 0; i < angulo1; i++){
		  setPWMAngulo(htim3, TIM_CHANNEL_2, 12500,i);
		  HAL_Delay(900);
	  }

	  // MOVER DE 90º a 180º
	  for(i = angulo1; i < angulo2; i++){
		  setPWMAngulo(htim3, TIM_CHANNEL_2, 12500,i);
		  HAL_Delay(900);
	  }
	 */

	  // TESTANDO DIFERENTES ÂNGULOS
	  setPWMAngulo(htim3, TIM_CHANNEL_2, 12500, 178);
	  HAL_Delay(800);

	  setPWMAngulo(htim3, TIM_CHANNEL_2, 12500, 156);
	  HAL_Delay(800);
	  setPWMAngulo(htim3, TIM_CHANNEL_2, 12500, 132);
	  HAL_Delay(800);

	  setPWMAngulo(htim3, TIM_CHANNEL_2, 12500, 147);
	  HAL_Delay(800);
	  setPWMAngulo(htim3, TIM_CHANNEL_2, 12500, 53);
	  HAL_Delay(800);
	  setPWMAngulo(htim3, TIM_CHANNEL_2, 12500, 72);
	  HAL_Delay(800);
	  setPWMAngulo(htim3, TIM_CHANNEL_2, 12500, 24);
	  HAL_Delay(800);
	  setPWMAngulo(htim3, TIM_CHANNEL_2, 12500, 0);
	  HAL_Delay(800);

  }
  /* USER CODE END 3 */
}

void SystemClock_Config(void)
{
  RCC_OscInitTypeDef RCC_OscInitStruct = {0};
  RCC_ClkInitTypeDef RCC_ClkInitStruct = {0};

  /** Configure the main internal regulator output voltage
  */
  __HAL_RCC_PWR_CLK_ENABLE();
  __HAL_PWR_VOLTAGESCALING_CONFIG(PWR_REGULATOR_VOLTAGE_SCALE3);
  /** Initializes the RCC Oscillators according to the specified parameters
  * in the RCC_OscInitTypeDef structure.
  */
  RCC_OscInitStruct.OscillatorType = RCC_OSCILLATORTYPE_HSI;
  RCC_OscInitStruct.HSIState = RCC_HSI_ON;
  RCC_OscInitStruct.HSICalibrationValue = RCC_HSICALIBRATION_DEFAULT;
  RCC_OscInitStruct.PLL.PLLState = RCC_PLL_NONE;
  if (HAL_RCC_OscConfig(&RCC_OscInitStruct) != HAL_OK)
  {
    Error_Handler();
  }
  /** Initializes the CPU, AHB and APB buses clocks
  */
  RCC_ClkInitStruct.ClockType = RCC_CLOCKTYPE_HCLK|RCC_CLOCKTYPE_SYSCLK
                              |RCC_CLOCKTYPE_PCLK1|RCC_CLOCKTYPE_PCLK2;
  RCC_ClkInitStruct.SYSCLKSource = RCC_SYSCLKSOURCE_HSI;
  RCC_ClkInitStruct.AHBCLKDivider = RCC_SYSCLK_DIV64;
  RCC_ClkInitStruct.APB1CLKDivider = RCC_HCLK_DIV8;
  RCC_ClkInitStruct.APB2CLKDivider = RCC_HCLK_DIV8;

  if (HAL_RCC_ClockConfig(&RCC_ClkInitStruct, FLASH_LATENCY_0) != HAL_OK)
  {
    Error_Handler();
  }
}

static void MX_TIM3_Init(void)
{

  TIM_ClockConfigTypeDef sClockSourceConfig = {0};
  TIM_MasterConfigTypeDef sMasterConfig = {0};
  TIM_OC_InitTypeDef sConfigOC = {0};

  htim3.Instance = TIM3;
  htim3.Init.Prescaler = 0;
  htim3.Init.CounterMode = TIM_COUNTERMODE_UP;
  htim3.Init.Period = 1250;
  htim3.Init.ClockDivision = TIM_CLOCKDIVISION_DIV1;
  htim3.Init.AutoReloadPreload = TIM_AUTORELOAD_PRELOAD_DISABLE;
  if (HAL_TIM_Base_Init(&htim3) != HAL_OK)
  {
    Error_Handler();
  }
  sClockSourceConfig.ClockSource = TIM_CLOCKSOURCE_INTERNAL;
  if (HAL_TIM_ConfigClockSource(&htim3, &sClockSourceConfig) != HAL_OK)
  {
    Error_Handler();
  }
  if (HAL_TIM_PWM_Init(&htim3) != HAL_OK)
  {
    Error_Handler();
  }
  sMasterConfig.MasterOutputTrigger = TIM_TRGO_RESET;
  sMasterConfig.MasterSlaveMode = TIM_MASTERSLAVEMODE_DISABLE;
  if (HAL_TIMEx_MasterConfigSynchronization(&htim3, &sMasterConfig) != HAL_OK)
  {
    Error_Handler();
  }
  sConfigOC.OCMode = TIM_OCMODE_PWM1;
  sConfigOC.Pulse = 94;
  sConfigOC.OCPolarity = TIM_OCPOLARITY_HIGH;
  sConfigOC.OCFastMode = TIM_OCFAST_DISABLE;
  if (HAL_TIM_PWM_ConfigChannel(&htim3, &sConfigOC, TIM_CHANNEL_2) != HAL_OK)
  {
    Error_Handler();
  }
  HAL_TIM_MspPostInit(&htim3);

}

static void MX_GPIO_Init(void)
{

  /* GPIO Ports Clock Enable */
  __HAL_RCC_GPIOC_CLK_ENABLE();
  __HAL_RCC_GPIOH_CLK_ENABLE();
  __HAL_RCC_GPIOA_CLK_ENABLE();

}

void Error_Handler(void)
{
  __disable_irq();
  while (1)
  {
  }
}

/************************ (C) COPYRIGHT STMicroelectronics *****END OF FILE****/
